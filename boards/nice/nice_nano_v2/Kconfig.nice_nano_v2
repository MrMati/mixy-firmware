## boards/nice/nice_nano_v2/nice_nano_v2_defconfig
```kconfig
CONFIG_ARM_MPU=y
CONFIG_HW_STACK_PROTECTION=y

CONFIG_FPU=y

CONFIG_PINCTRL=y
CONFIG_GPIO=y
CONFIG_ADC=y
```

## drivers/Kconfig
```kconfig
menu "Drivers"
rsource "ext_power/Kconfig"
rsource "pots/Kconfig"
rsource "sensor/battery/Kconfig"
rsource "usbd_reset/Kconfig"
endmenu
```

## drivers/ext_power/Kconfig
```kconfig
menuconfig EXT_POWER
	bool "External power control driver"
	depends on DT_HAS_MIXY_EXT_POWER_ENABLED
	select GPIO
	help
	  This option enables the external power control driver.

if EXT_POWER

config EXT_POWER_INIT_PRIORITY
	int "External power control driver init priority"
	default KERNEL_INIT_PRIORITY_DEVICE
	help
	  External power control driver init priority.

module = EXT_POWER
module-str = ext_power
source "subsys/logging/Kconfig.template.log_config"

endif # EXT_POWER
```

## drivers/pots/Kconfig
```kconfig
menuconfig POTS
	bool "Pots device drivers"
	help
	  This option enables the pots custom driver class.

if POTS

config POTS_INIT_PRIORITY
	int "Pots device drivers init priority"
	default KERNEL_INIT_PRIORITY_DEVICE
	help
	  Pots device drivers init priority.

module = POTS
module-str = pots
source "subsys/logging/Kconfig.template.log_config"

rsource "Kconfig.pots"

endif # POTS
```

## drivers/pots/Kconfig.pots
```kconfig
menu "Pots driver options"

config POTS_LOG_LEVEL
    int "Pots driver log level"
    default 3
    help
      Set the logging level for the Pots driver.
      0: None, 1: Error, 2: Warning, 3: Info, 4: Debug

endmenu
```

## drivers/sensor/battery/Kconfig
```kconfig
DT_COMPAT_MIXY_BATTERY_NRF_VDDH := mixy,battery-nrf-vddh

config MIXY_BATTERY
    bool "Mixy battery monitoring"
    help
        Enable battery monitoring


config MIXY_BATTERY_NRF_VDDH
    bool
    default $(dt_compat_enabled,$(DT_COMPAT_MIXY_BATTERY_NRF_VDDH))
    select ADC
    select MIXY_BATTERY
    depends on SENSOR
    help
        Enable Mixy nRF VDDH voltage driver for battery monitoring.

if MIXY_BATTERY

module = MIXY_BATTERY
module-str = mixy_battery
source "subsys/logging/Kconfig.template.log_config"

rsource "Kconfig.battery"

endif # MIXY_BATTERY
```

## drivers/sensor/battery/Kconfig.battery
```kconfig
menu "Battery driver options"

config MIXY_LOG_LEVEL
    int "Battery driver log level"
    default 3
    help
      Set the logging level for the Battery driver.
      0: None, 1: Error, 2: Warning, 3: Info, 4: Debug

endmenu
```

## drivers/usbd_reset/Kconfig
```kconfig
config USBD_RESET_CLASS
	bool "USB Reset class implementation"
	depends on DT_HAS_MIXY_RESET_ENABLED
	depends on USB_DEVICE_STACK_NEXT
	default y
	help
	  USB device custom reset class implementation.

if USBD_RESET_CLASS

module = USBD_RESET
module-str = usbd reset
default-count = 1
source "subsys/logging/Kconfig.template.log_config"

endif
```

## dts/bindings/mixy,ext-power.yaml
```yaml
description: |
  Generic driver for controlling the external power output
  by toggling the control-gpio pin status
  (Only in supported hardware)

compatible: "mixy,ext-power"

properties:
  control-gpios:
    type: phandle-array
    required: true
```

## dts/bindings/mixy,pots.yaml
```yaml
description: >
  Potentiometer array via 1-to-2 multiplexer
compatible: "mixy,pots"
properties:
  io-channels:
    description: "ADC channels for first MUX inputs"
    type: phandle-array
    required: true
  mux-gpios:
    description: "GPIO controlling MUX select line"
    type: phandle-array
    required: true
  "#io-channel-cells":
    type: int
    const: 1
    description: "Number of cells in IO channel specifiers"
```

## dts/bindings/mixy,reset.yaml
```yaml
description: USB Reset interface

compatible: "mixy,reset"

on-bus: usb

properties:
  label:
    type: string
    description: |
      The string defined by the label property is also used for the USB
      interface string descriptor.
```

## west.yml
```yaml
manifest:
  remotes:
    - name: zephyrproject-rtos
      url-base: https://github.com/zephyrproject-rtos

  projects:
    - name: zephyr
      remote: zephyrproject-rtos
      revision: main
      import:
        name-allowlist:
          - cmsis_6    # required by the ARM port for Cortex-M
          - hal_nordic # required by the custom_plank board (Nordic based)
          - mbedtls    # for BT SMP
```
