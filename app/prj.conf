## CMakeLists.txt
```
cmake_minimum_required(VERSION 3.13.1)
find_package(Zephyr REQUIRED HINTS $ENV{ZEPHYR_BASE})

project(app LANGUAGES C)

FILE(GLOB app_sources src/*.c)
target_sources(app PRIVATE
  ${app_sources}
  )

target_sources_ifdef(CONFIG_RESET_INTERFACE_INITIALIZE_AT_BOOT 
  app PRIVATE  
  src/utils/usbd_reset_register.c
  src/utils/serial_num.c
)
```

## Kconfig
```
menu "Zephyr"
source "Kconfig.zephyr"
endmenu

config USE_REAL_MIDI_UUID
	bool "Use proper UUID for MIDI service"
	default y
	help
	  Enable for compatibility with 3rdparty BLE MIDI software

rsource "Kconfig.reset_interface"

module = APP
module-str = APP
source "subsys/logging/Kconfig.template.log_config"
```

## Kconfig.reset_interface
```
menuconfig RESET_INTERFACE_INITIALIZE_AT_BOOT
	bool "Initialize USB device and CDC ACM UART at boot"
	depends on USBD_RESET_CLASS
	help
	  This will probably work only in applications where no other USB features are
	  required, configured, and enabled.

if RESET_INTERFACE_INITIALIZE_AT_BOOT

config RESET_INTERFACE_ENABLE_AT_BOOT
	bool "USB device will be enabled at boot"
	default y
	help
	  When disabled, the application is responsible for enabling/disabling
	  the USB device.

config RESET_INTERFACE_MANUFACTURER_STRING
	string "USB device manufacturer string descriptor"
	default "Mixy"
	help
	  USB device manufacturer string descriptor.

config RESET_INTERFACE_PRODUCT_STRING
	string "USB device product string descriptor"
	default "RESET"
	help
	  USB device product string descriptor.

config RESET_INTERFACE_VID
	hex "USB device Vendor ID"
	default 0x2fe3
	help
	  You can use any VID you like.

config RESET_INTERFACE_PID
	hex "USB device Product ID"
	default 0x1337
	help
	  You can use any PID you like.

config RESET_INTERFACE_SELF_POWERED
	bool "USB device Self-powered attribute"
	default y
	help
	  Set the Self-powered attribute in the configuration.

config RESET_INTERFACE_MAX_POWER
	int "USB device bMaxPower value"
	default 125
	range 0 250
	help
	  bMaxPower value in the configuration in 2 mA units.

endif #RESET_INTERFACE_INITIALIZE_AT_BOOT
```

## prj.conf
```kconfig
# drivers
CONFIG_POTS=y
CONFIG_SENSOR=y
CONFIG_EXT_POWER=y

# bluetooth
CONFIG_BT=y
CONFIG_BT_PERIPHERAL=y
CONFIG_BT_DIS=y
CONFIG_BT_BAS=y
CONFIG_BT_DEVICE_NAME="Mixy"
CONFIG_BT_DEVICE_APPEARANCE=2176
CONFIG_BT_DIS_PNP=n
CONFIG_BT_DIS_MANUF_NAME_STR="MixyLabs"
CONFIG_BT_DIS_MODEL_NUMBER_STR="Mixy Beta"
CONFIG_BT_DIS_SERIAL_NUMBER=y
CONFIG_BT_DIS_SERIAL_NUMBER_STR="0000"
CONFIG_BT_DIS_FW_REV=y
CONFIG_BT_DIS_HW_REV=y
CONFIG_BT_DIS_HW_REV_STR="A"

# for dynamic serial number
CONFIG_SETTINGS=y
CONFIG_SETTINGS_RUNTIME=y
CONFIG_BT_DIS_SETTINGS=y

CONFIG_BT_GAP_AUTO_UPDATE_CONN_PARAMS=y
CONFIG_BT_PERIPHERAL_PREF_MIN_INT=50
CONFIG_BT_PERIPHERAL_PREF_MAX_INT=70
CONFIG_BT_PERIPHERAL_PREF_LATENCY=4
CONFIG_BT_PERIPHERAL_PREF_TIMEOUT=400

CONFIG_BT_BUF_ACL_RX_SIZE=44
CONFIG_BT_BUF_ACL_TX_SIZE=44
CONFIG_BT_L2CAP_TX_MTU=40

# power
CONFIG_PM_DEVICE=y
CONFIG_NRFX_POWER=y
CONFIG_PM_DEVICE_RUNTIME=y

# build
CONFIG_USE_DT_CODE_PARTITION=y
CONFIG_BUILD_OUTPUT_UF2=y

# code size optimizations
CONFIG_ISR_TABLES_LOCAL_DECLARATION=y # for LTO
CONFIG_LTO=y
CONFIG_GPIO_NRFX_INTERRUPT=n
CONFIG_BOOT_BANNER=n
CONFIG_PRINTK=n


# non volatile storage
# CONFIG_MPU_ALLOW_FLASH_WRITE=y
# CONFIG_NVS=y
# CONFIG_SETTINGS_NVS=y
# CONFIG_FLASH=y
# CONFIG_FLASH_PAGE_LAYOUT=y
# CONFIG_FLASH_MAP=y
```

## logging.conf
```kconfig
CONFIG_LOG=y
CONFIG_SERIAL=y
CONFIG_CONSOLE=y   # for printk
CONFIG_UART_CONSOLE=y
CONFIG_PRINTK=y

CONFIG_LOG_BACKEND_UART=y
CONFIG_APP_LOG_LEVEL_DBG=y
CONFIG_BT_LOG_LEVEL_WRN=y
CONFIG_USBD_LOG_LEVEL_WRN=y
CONFIG_UDC_DRIVER_LOG_LEVEL_WRN=y
```

## midi_compat.conf
```kconfig
CONFIG_USE_REAL_MIDI_UUID=n
```

## usb.conf
```kconfig
CONFIG_USB_DEVICE_STACK_NEXT=y

CONFIG_RESET_INTERFACE_INITIALIZE_AT_BOOT=y
CONFIG_RESET_INTERFACE_ENABLE_AT_BOOT=n
```

## src/main.c
```c
#include <app/drivers/pots.h>
#include <stddef.h>
#include <string.h>
#include <zephyr/bluetooth/bluetooth.h>
#include <zephyr/bluetooth/conn.h>
#include <zephyr/bluetooth/gatt.h>
#include <zephyr/bluetooth/hci.h>
#include <zephyr/bluetooth/services/bas.h>
#include <zephyr/bluetooth/uuid.h>
#include <zephyr/devicetree.h>
#include <zephyr/drivers/sensor.h>
#include <zephyr/kernel.h>
#include <zephyr/logging/log.h>
#include <zephyr/types.h>

#include "ble_midi.h"

LOG_MODULE_REGISTER(main, CONFIG_APP_LOG_LEVEL);

static void ble_midi_started(void);
static void pots_data_task(struct k_work *work);
static void bas_notify_task(struct k_work *work);

static K_WORK_DELAYABLE_DEFINE(data_out_work, pots_data_task);
static K_WORK_DELAYABLE_DEFINE(battery_update_work, bas_notify_task);

/*     BLUETOOTH    */

static const struct bt_data ad[] = {
    BT_DATA_BYTES(BT_DATA_FLAGS, (BT_LE_AD_GENERAL | BT_LE_AD_NO_BREDR)),
    BT_DATA(BT_DATA_NAME_COMPLETE, CONFIG_BT_DEVICE_NAME, sizeof(CONFIG_BT_DEVICE_NAME) - 1),
    /*BT_DATA_BYTES(BT_DATA_UUID16_ALL,
                  BT_UUID_16_ENCODE(BT_UUID_DIS_VAL),
                  BT_UUID_16_ENCODE(BT_UUID_BAS_VAL)),*/
    BT_DATA_BYTES(BT_DATA_UUID128_ALL, BT_UUID_REAL_MIDI_VAL), // so evil
};

/*static const struct bt_data sd[] = {
    BT_DATA(BT_DATA_NAME_COMPLETE, CONFIG_BT_DEVICE_NAME, sizeof(CONFIG_BT_DEVICE_NAME) - 1),
};*/

#define BT_LE_ADV_PARAMS BT_LE_ADV_PARAM(BT_LE_ADV_OPT_CONN, 0x960, 0xC80, NULL)  // 1.5s to 2s interval

static bool bt_connected = false;

static void connected(struct bt_conn *conn, uint8_t err) {
    if (err) {
        LOG_ERR("Connection failed, err 0x%02x", err);
    } else {
        LOG_INF("Connected");
        bt_connected = true;
        k_work_schedule(&battery_update_work, K_NO_WAIT);
    }
}

static void disconnected(struct bt_conn *conn, uint8_t reason) {
    LOG_INF("Disconnected, reason 0x%02x %s", reason, bt_hci_err_to_str(reason));
    bt_connected = false;
}

static void bt_recycled() {
    LOG_DBG("Connection recycled");
    int err = bt_le_adv_start(BT_LE_ADV_PARAMS, ad, ARRAY_SIZE(ad), NULL, 0);
    if (err) {
        LOG_ERR("Advertising failed to start (err %d)", err);
        return;
    }

    LOG_DBG("Advertising restarted");
}

BT_CONN_CB_DEFINE(conn_callbacks) = {
    .connected = connected,
    .disconnected = disconnected,
    .recycled = bt_recycled};

static void bt_ready(void) {
    LOG_INF("Bluetooth initialized");

    ble_midi_init(ble_midi_started);

    int err = bt_le_adv_start(BT_LE_ADV_PARAMS, ad, ARRAY_SIZE(ad), NULL, 0);
    if (err) {
        LOG_ERR("Advertising failed to start (err %d)", err);
        return;
    }

    LOG_INF("Advertising started");
}

/*     BATTERY    */
static const struct device *const battery = DEVICE_DT_GET(DT_CHOSEN(mixy_battery));

static void bas_notify_task(struct k_work *work) {
    struct sensor_value state_of_charge;
    int ret;

    ret = sensor_sample_fetch_chan(battery, SENSOR_CHAN_GAUGE_STATE_OF_CHARGE);
    if (ret != 0) {
        LOG_INF("Failed to fetch battery values: %d", ret);
        return;
    }

    ret = sensor_channel_get(battery, SENSOR_CHAN_GAUGE_STATE_OF_CHARGE, &state_of_charge);
    if (ret != 0) {
        LOG_INF("Failed to get battery state of charge: %d", ret);
        return;
    }

    ret = bt_bas_set_battery_level(state_of_charge.val1);
    if (ret) {
        LOG_INF("Failed to update battery level: %d", ret);
        // keep trying
    }

    if (bt_connected) {
        k_work_schedule(&battery_update_work, K_SECONDS(60));
    }
}

/*     APP     */

static inline uint8_t pot_val_norm(uint16_t raw_val) {
    uint8_t value_norm = (uint8_t)((127 * raw_val) / 930);
    if (value_norm >= 127) value_norm = 127;
    return value_norm;
}

static void send_pot_vals(int *idxs, uint16_t *vals, int count) {
    static uint8_t pot_idx_mapping[6] = {5, 3, 1, 6, 4, 2};

    // Worst case: 1 header + count * (1 ts + 3 MIDI)
    uint8_t packet[1 + 6 * 4];
    int offset = 0;

    uint16_t timestamp = 0;  // use k_uptime_get if ever needed

    // BLE-MIDI header: MSB=1 + high 6 bits of timestamp
    packet[offset++] = 0x80 | ((timestamp >> 7) & 0x3F);

    for (int i = 0; i < count; i++) {
        int pot_idx = idxs[i];

        // Timestamp low bits (MSB=1 + low 7 bits)
        packet[offset++] = 0x80 | (timestamp & 0x7F);

        // MIDI CC message
        packet[offset++] = 0xB0;                      // CC on channel 0
        packet[offset++] = pot_idx_mapping[pot_idx];  // CC number
        packet[offset++] = pot_val_norm(vals[i]);     // CC value
    }

    int ret = ble_midi_send_packet(packet, offset);
    if (ret < 0) {
        LOG_ERR("MIDI packet notify failed (0x%02X)", -ret);
    }
}

static void send_all_pot_vals(uint16_t *vals) {
    int idxs[6] = {0, 1, 2, 3, 4, 5};
    send_pot_vals(idxs, vals, 6);
}

static void send_pot_val(int idx, uint16_t val) {
    send_pot_vals(&idx, &val, 1);
}

#define POTS_AMOUNT 6

static bool sent_initial_vals = false;
static const struct device *pots;
static uint16_t prev_pot_vals[POTS_AMOUNT];
static int64_t last_change_time;

static struct pots_params params;

static void reset_pots_params(void) {
    params.minimum_change = 10;
    params.slow_refresh_period_ms = 400;
    params.fast_refresh_period_ms = 70;
    params.fast_refresh_retention_ms = 300;
}

static void ble_midi_started(void) {
    sent_initial_vals = false;

    uint16_t curr_pot_vals[POTS_AMOUNT];
    mixy_pots_read(pots, curr_pot_vals);
    memcpy(prev_pot_vals, curr_pot_vals, sizeof(prev_pot_vals));
    last_change_time = k_uptime_get();

    k_work_schedule(&data_out_work, K_NO_WAIT);
}

static void pots_send_initial(void) {
    sent_initial_vals = true;

    uint16_t curr_pot_vals[POTS_AMOUNT];
    mixy_pots_read(pots, curr_pot_vals);
    send_all_pot_vals(curr_pot_vals);
    memcpy(prev_pot_vals, curr_pot_vals, sizeof(prev_pot_vals));
}

static void pots_data_task(struct k_work *work) {
    if (!ble_midi_is_started() || !bt_connected) return;
    
    if (ble_midi_params_changed()) {
        ble_midi_get_params(&params);
    }

    uint16_t curr_pot_vals[POTS_AMOUNT];
    mixy_pots_read(pots, curr_pot_vals);

    bool changed = false;

    for (uint8_t i = 0; i < POTS_AMOUNT; i++) {
        if (i == 3) continue;  // ignore pot 3 as it is NC
        if (abs(curr_pot_vals[i] - prev_pot_vals[i]) > params.minimum_change) {
            if(sent_initial_vals) send_pot_val(i, curr_pot_vals[i]);
            prev_pot_vals[i] = curr_pot_vals[i];
            changed = true;
        }
    }

    if (changed) {
        last_change_time = k_uptime_get();
        if(!sent_initial_vals) pots_send_initial();
    }

    if (k_uptime_get() - last_change_time > params.fast_refresh_retention_ms) {
        k_work_schedule(&data_out_work, K_MSEC(params.slow_refresh_period_ms));
    } else {
        k_work_schedule(&data_out_work, K_MSEC(params.fast_refresh_period_ms));
    }
}

int main(void) {
    int ret;

    pots = DEVICE_DT_GET(DT_NODELABEL(pots));
    if (!device_is_ready(pots)) {
        LOG_ERR("Pots not ready");
        return 0;
    }

    reset_pots_params();

    ret = bt_enable(NULL);
    if (ret) {
        LOG_ERR("Bluetooth init failed (err %d)", ret);
        return 0;
    }
    bt_ready();

    LOG_INF("Mixy init done");

    while (1) {
        k_sleep(K_FOREVER);
    }

    return 0;
}
```

## src/ble_midi.c
```c
#include "ble_midi.h"

#include <errno.h>
#include <stdio.h>
#include <string.h>
#include <zephyr/bluetooth/bluetooth.h>
#include <zephyr/bluetooth/conn.h>
#include <zephyr/bluetooth/gatt.h>
#include <zephyr/bluetooth/hci.h>
#include <zephyr/bluetooth/uuid.h>
#include <zephyr/kernel.h>
#include <zephyr/logging/log.h>
#include <zephyr/sys/byteorder.h>
#include <zephyr/sys/printk.h>

LOG_MODULE_REGISTER(ble_midi, CONFIG_APP_LOG_LEVEL);

static void (*ble_midi_started_cb)(void);
static bool ble_midi_started = false;

static struct pots_params params;
static bool params_changed = false;

static void htmc_ccc_cfg_changed(const struct bt_gatt_attr *attr,
                                 uint16_t value) {
    uint8_t notification_enabled = (value == BT_GATT_CCC_NOTIFY) ? 1 : 0;
    LOG_DBG("MIDI Notifications %s",
            notification_enabled ? "enabled" : "disabled");

    if (!notification_enabled) {
        ble_midi_started = false;
    }
}

ssize_t midi_read_char(struct bt_conn *conn, const struct bt_gatt_attr *attr,
                       void *buf, uint16_t len, uint16_t offset) {
    if (!ble_midi_started) {
        ble_midi_started = true;
        if (ble_midi_started_cb) ble_midi_started_cb();
        LOG_DBG("MIDI started");
    }

    return bt_gatt_attr_read(conn, attr, buf, len, offset, NULL, 0);
}

static ssize_t midi_write_char(struct bt_conn *conn, const struct bt_gatt_attr *attr, const void *buf,
                               uint16_t len, uint16_t offset, uint8_t flags) {
    if (len >= 8) {
        params.minimum_change = sys_get_le16(buf);
        params.slow_refresh_period_ms = sys_get_le16((uint8_t *)buf + 2);
        params.fast_refresh_period_ms = sys_get_le16((uint8_t *)buf + 4);
        params.fast_refresh_retention_ms = sys_get_le16((uint8_t *)buf + 6);

        params_changed = true;
    }
    return len;
}

BT_GATT_SERVICE_DEFINE(midi_ble_svc,
                       BT_GATT_PRIMARY_SERVICE(BT_UUID_MIDI),
                       BT_GATT_CHARACTERISTIC(BT_UUID_MIDI_CHAR, BT_GATT_CHRC_READ | BT_GATT_CHRC_WRITE_WITHOUT_RESP | BT_GATT_CHRC_NOTIFY,
                                              BT_GATT_PERM_READ | BT_GATT_PERM_WRITE, midi_read_char, midi_write_char, NULL),
                       BT_GATT_CCC(htmc_ccc_cfg_changed, BT_GATT_PERM_READ | BT_GATT_PERM_WRITE), );

void ble_midi_init(void (*ble_midi_started_cb_)(void)) {
    ble_midi_started_cb = ble_midi_started_cb_;
}

bool ble_midi_is_started(void) {
    return ble_midi_started;
}

bool ble_midi_params_changed(void) {
    return params_changed;
}

void ble_midi_get_params(struct pots_params *out_params) {
    if (out_params) {
        memcpy(out_params, &params, sizeof(params));
    }
    params_changed = false;
}

int ble_midi_send_packet(const uint8_t *data, size_t len) {
    if (!ble_midi_started) {
        return -EACCES;
    }

    return bt_gatt_notify(NULL, &midi_ble_svc.attrs[1], data, len);
}
```

## src/ble_midi.h
```c
#pragma once

#include <stdbool.h>
#include <stddef.h>
#include <stdint.h>

#define BT_UUID_REAL_MIDI_VAL BT_UUID_128_ENCODE(0x03B80E5A, 0xEDE8, 0x4B33, 0xA751, 0x6CE34EC4C700)
#define BT_UUID_FAKE_MIDI_VAL BT_UUID_128_ENCODE(0x03B80E5A, 0xEDE8, 0x4B33, 0xA751, 0x6CE34EC4C705)

#if CONFIG_USE_REAL_MIDI_UUID
#define BT_UUID_MIDI_VAL BT_UUID_REAL_MIDI_VAL
#else
#define BT_UUID_MIDI_VAL BT_UUID_FAKE_MIDI_VAL
#endif

#define BT_UUID_MIDI BT_UUID_DECLARE_128(BT_UUID_MIDI_VAL)
#define BT_UUID_MIDI_CHAR BT_UUID_DECLARE_128(BT_UUID_128_ENCODE(0x7772E5DB, 0x3868, 0x4112, 0xA1A9, 0xF2669D106BF3))

struct pots_params {
    uint16_t minimum_change;
    uint16_t slow_refresh_period_ms;
    uint16_t fast_refresh_period_ms;
    uint16_t fast_refresh_retention_ms;
};

void ble_midi_init(void (*ble_midi_started_cb)(void));
bool ble_midi_is_started(void);
bool ble_midi_params_changed(void);
void ble_midi_get_params(struct pots_params *out_params);
int ble_midi_send_packet(const uint8_t *data, size_t len);
```
